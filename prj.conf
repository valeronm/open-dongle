## CMakeLists.txt
```
cmake_minimum_required(VERSION 3.20.0)

find_package(Zephyr REQUIRED HINTS $ENV{ZEPHYR_BASE})
project(open_dongle)

set(manifest ${CMAKE_CURRENT_SOURCE_DIR}/tool/Cargo.toml)
set_property(DIRECTORY APPEND PROPERTY CMAKE_CONFIGURE_DEPENDS ${manifest})
file(STRINGS ${manifest} version_line REGEX "^version = \"[0-9]+\\.[0-9]+\\.[0-9]+\"$" LIMIT_COUNT 1)
if(NOT version_line MATCHES "([0-9]+)\\.([0-9]+)\\.([0-9]+)")
  message(FATAL_ERROR "no version line in ${manifest}")
endif()
set_property(SOURCE src/core.c APPEND PROPERTY COMPILE_DEFINITIONS
  FIRMWARE_VERSION_MAJOR=${CMAKE_MATCH_1} FIRMWARE_VERSION_MINOR=${CMAKE_MATCH_2}
  FIRMWARE_VERSION_PATCH=${CMAKE_MATCH_3})

target_sources(app PRIVATE
  src/main.c src/core.c src/nuphy_main.c src/unifying_main.c src/radio.c src/noise.c src/usb.c
  src/indicator.c src/nuphy.c src/unifying.c src/protocol.c src/reports.c src/chanpick.c
  src/link.c src/store.c src/diag.c src/diagproto.c src/history.c src/pairwin.c src/chanwatch.c)
```

## Kconfig
```
mainmenu "open-dongle"

config COUNTERS
	bool "Print link and USB counters on the console every 10 s"
	default y

config UNIFYING_POC
	bool "Build the Logitech Unifying pairing proof of concept instead of the NuPhy receiver"
	select ENTROPY_GENERATOR

source "Kconfig.zephyr"
```

## prj.conf
```kconfig
CONFIG_SERIAL=y
CONFIG_CONSOLE=y
CONFIG_UART_CONSOLE=y
CONFIG_UART_LINE_CTRL=y
CONFIG_PRINTK=y
CONFIG_USB_DEVICE_STACK_NEXT=y
CONFIG_CDC_ACM_SERIAL_INITIALIZE_AT_BOOT=n
CONFIG_USBD_CDC_ACM_CLASS=y
CONFIG_USBD_HID_SUPPORT=y
CONFIG_HWINFO=y
CONFIG_REBOOT=y
CONFIG_MAIN_STACK_SIZE=2048
CONFIG_ESB=y
CONFIG_CLOCK_CONTROL=y
CONFIG_ESB_CLOCK_INIT=y
CONFIG_FLASH=y
CONFIG_FLASH_MAP=y
CONFIG_NVS=y
CONFIG_SETTINGS=y
CONFIG_SETTINGS_NVS=y
CONFIG_WATCHDOG=y
CONFIG_ENTROPY_GENERATOR=y
```

## app.overlay
```dts
/ {
	hid_keyboard: hid_keyboard {
		compatible = "zephyr,hid-device";
		label = "HID keyboard";
		protocol-code = "keyboard";
		in-report-size = <8>;
		in-polling-period-us = <1000>;
	};

	hid_extra: hid_extra {
		compatible = "zephyr,hid-device";
		label = "HID media";
		protocol-code = "none";
		in-report-size = <3>;
		in-polling-period-us = <1000>;
	};

	hid_diag: hid_diag {
		compatible = "zephyr,hid-device";
		label = "HID diag";
		protocol-code = "none";
		in-report-size = <64>;
		in-polling-period-us = <1000>;
		out-report-size = <64>;
		out-polling-period-us = <1000>;
	};
};
```

## src/main.c
```c
#include <zephyr/drivers/hwinfo.h>
#include <zephyr/sys/printk.h>
#include "core.h"
#include "store.h"

int main(void)
{
	uint32_t reset_cause = 0;
	uint8_t stored = 0;
	bool loaded = false;
	enum protocol active;
	int store_err;

	hwinfo_get_reset_cause(&reset_cause);
	hwinfo_clear_reset_cause();
	store_err = store_init();
	if (store_err) {
		printk("store init failed: %d\n", store_err);
	} else {
		loaded = store_load_protocol(&stored);
	}
	active = protocol_from_stored(loaded, stored);
	core_start(active);
	if (active == PROTOCOL_UNIFYING) {
		unifying_run(store_err, reset_cause);
	}
	nuphy_run(store_err, reset_cause);
	return 0;
}
```

## src/chanmove.h
```c
#ifndef CHANMOVE_H
#define CHANMOVE_H

enum chanmove_result {
	CHANMOVE_DONE,
	/* The keyboard never looks for the dongle on that channel. */
	CHANMOVE_NOT_A_CHANNEL,
	/* No keyboard paired, pairing open or, in Unifying, a pairing handshake running. */
	CHANMOVE_NOT_MOVABLE,
};

#endif
```

## src/chanpick.c
```c
#include <stdbool.h>
#include <stdlib.h>
#include <string.h>
#include "chanpick.h"

#define NEIGHBORS 5

/* The RF channels of BLE advertising channels 37, 38 and 39; 2 and 80 are also the keyboard's
 * pairing channels. */
static const uint8_t excluded_channels[] = {2, 26, 80};

static bool excluded(int ch)
{
	for (size_t i = 0; i < sizeof(excluded_channels); i++) {
		if (ch == excluded_channels[i]) {
			return true;
		}
	}
	return false;
}

/* Wi-Fi transmits in bursts, which a mean would hide. */
static int8_t busy_level(const int8_t samples[CHAN_SAMPLES])
{
	int8_t sorted[CHAN_SAMPLES];

	memcpy(sorted, samples, sizeof(sorted));
	for (int i = 1; i < CHAN_SAMPLES; i++) {
		int8_t v = sorted[i];
		int j = i - 1;

		while (j >= 0 && sorted[j] > v) {
			sorted[j + 1] = sorted[j];
			j--;
		}
		sorted[j + 1] = v;
	}
	return sorted[CHAN_SAMPLES * 9 / 10];
}

/* A lull inside a Wi-Fi band is not a quiet channel. */
static int8_t band_level(const int8_t busy[CHAN_COUNT], int i)
{
	int8_t level = INT8_MIN;

	for (int j = i - NEIGHBORS; j <= i + NEIGHBORS; j++) {
		if (j >= 0 && j < CHAN_COUNT && busy[j] > level) {
			level = busy[j];
		}
	}
	return level;
}

void chan_pick(const struct chan_survey *s, uint8_t out[3])
{
	int8_t busy[CHAN_COUNT];
	int8_t level[CHAN_COUNT];

	for (int i = 0; i < CHAN_COUNT; i++) {
		busy[i] = busy_level(s->dbm[i]);
	}
	for (int i = 0; i < CHAN_COUNT; i++) {
		level[i] = band_level(busy, i);
	}
	for (int pick = 0; pick < 3; pick++) {
		int best = -1;

		for (int i = 0; i < CHAN_COUNT; i++) {
			int ch = CHAN_FIRST + i;
			bool near = false;

			for (int p = 0; p < pick; p++) {
				near |= abs(ch - out[p]) < CHAN_MIN_SPACING;
			}
			if (!near && !excluded(ch) && (best < 0 || level[i] < level[best])) {
				best = i;
			}
		}
		out[pick] = (uint8_t)(CHAN_FIRST + best);
	}
}
```

## src/chanpick.h
```c
#ifndef CHANPICK_H
#define CHANPICK_H

#include <stdbool.h>
#include <stdint.h>

#define CHAN_FIRST 2
#define CHAN_LAST 80
#define CHAN_COUNT (CHAN_LAST - CHAN_FIRST + 1)
#define CHAN_SAMPLES 32
#define CHAN_MIN_SPACING 10

static inline bool chan_in_range(int ch)
{
	return ch >= CHAN_FIRST && ch <= CHAN_LAST;
}

struct chan_survey {
	int8_t dbm[CHAN_COUNT][CHAN_SAMPLES];
};

/*
 * Writes the three quietest channels at least CHAN_MIN_SPACING apart, never a BLE advertising
 * channel, quietest first.
 */
void chan_pick(const struct chan_survey *s, uint8_t out[3]);

#endif
```

## src/chanwatch.c
```c
#include <string.h>
#include "chanwatch.h"

void chanwatch_init(struct chanwatch *w, const uint8_t *channels, size_t n, uint64_t now_ms)
{
	memset(w, 0, sizeof(*w));
	w->count = n < CHANWATCH_MAX ? n : CHANWATCH_MAX;
	if (w->count > 0) {
		memcpy(w->channels, channels, w->count);
	}
	w->decayed_ms = now_ms;
}

static int index_of(const struct chanwatch *w, uint8_t channel)
{
	for (size_t i = 0; i < w->count; i++) {
		if (w->channels[i] == channel) {
			return (int)i;
		}
	}
	return -1;
}

/* A linear step stands in for the exponential, since rounds come far more often than the decay
 * time. */
static void decay(struct chanwatch *w, uint64_t now_ms)
{
	uint64_t dt;
	float keep;

	if (now_ms <= w->decayed_ms) {
		return;
	}
	dt = now_ms - w->decayed_ms;
	keep = dt >= CHANWATCH_DECAY_MS ? 0.0f : 1.0f - (float)dt / CHANWATCH_DECAY_MS;
	for (size_t i = 0; i < w->count; i++) {
		for (int b = 0; b < NOISE_BUCKETS; b++) {
			w->weight[i][b] *= keep;
		}
	}
	w->decayed_ms = now_ms;
}

void chanwatch_round(struct chanwatch *w, const int8_t *dbm, uint8_t home, uint64_t now_ms)
{
	decay(w, now_ms);
	for (size_t i = 0; i < w->count; i++) {
		if (w->channels[i] != home) {
			w->weight[i][noise_bucket(dbm[i])] += 1.0f;
		}
	}
}

void chanwatch_home(struct chanwatch *w, uint8_t home, const struct noise_tally *t)
{
	int i = index_of(w, home);

	if (i < 0) {
		return;
	}
	for (int b = 0; b < NOISE_BUCKETS; b++) {
		w->weight[i][b] += (float)t->buckets[b];
	}
}

static float sum_from(const float *weight, uint8_t from)
{
	float sum = 0.0f;

	for (int b = from; b < NOISE_BUCKETS; b++) {
		sum += weight[b];
	}
	return sum;
}

/* A threshold counts the whole bucket it falls in. */
static uint8_t threshold_bucket(int8_t weakest_dbm)
{
	int t = weakest_dbm - CHANWATCH_MARGIN_DB;

	return noise_bucket((int8_t)(t < NOISE_BUSY_DBM ? NOISE_BUSY_DBM : t));
}

void chanwatch_hold(struct chanwatch *w, uint64_t now_ms)
{
	w->hold_until_ms = now_ms + CHANWATCH_HOLD_MS;
}

bool chanwatch_decide(struct chanwatch *w, uint8_t home, int8_t weakest_dbm, uint64_t now_ms,
		      struct chanwatch_move *out)
{
	int h = index_of(w, home);
	uint8_t from = threshold_bucket(weakest_dbm);
	float home_n;
	float home_share;
	float best_n = 0.0f;
	float best_harmful = 0.0f;
	float best_share;
	float limit;
	float gap;
	int best = -1;

	if (h < 0 || now_ms < w->hold_until_ms) {
		return false;
	}
	home_n = sum_from(w->weight[h], 0);
	if (home_n <= 0.0f) {
		return false;
	}
	home_share = sum_from(w->weight[h], from) / home_n;
	for (size_t i = 0; i < w->count; i++) {
		float n = sum_from(w->weight[i], 0);
		float k;

		if ((int)i == h || n < CHANWATCH_MIN_SAMPLES) {
			continue;
		}
		k = sum_from(w->weight[i], from);
		if (best < 0 || k * best_n < best_harmful * n) {
			best = (int)i;
			best_n = n;
			best_harmful = k;
		}
	}
	if (best < 0) {
		return false;
	}
	best_share = best_harmful / best_n;
	limit = home_share / 2.0f < home_share - 0.02f ? home_share / 2.0f : home_share - 0.02f;
	gap = limit - best_share;
	/*
	 * The candidate's Wilson upper bound at 3 standard deviations must lie below limit: the
	 * best of many candidates reads low by luck. Home's readings far outnumber a candidate's,
	 * so home's share is taken as exact.
	 */
	if (gap <= 0.0f || best_n * gap * gap <= 9.0f * limit * (1.0f - limit)) {
		return false;
	}
	out->to = w->channels[best];
	out->home_share = (uint16_t)(home_share * NOISE_SHARE_FULL + 0.5f);
	out->to_share = (uint16_t)(best_share * NOISE_SHARE_FULL + 0.5f);
	chanwatch_hold(w, now_ms);
	return true;
}
```

## src/chanwatch.h
```c
#ifndef CHANWATCH_H
#define CHANWATCH_H

#include <stdbool.h>
#include <stddef.h>
#include <stdint.h>
#include "noise.h"

#define CHANWATCH_MAX 11
#define CHANWATCH_DECAY_MS 300000
#define CHANWATCH_HOLD_MS 60000
#define CHANWATCH_MIN_SAMPLES 50
/* Assumed: the nearest datasheet figure is 7.1 dB co-channel rejection for Bluetooth LE at
 * 2 Mbps. */
#define CHANWATCH_MARGIN_DB 10

struct chanwatch {
	uint8_t channels[CHANWATCH_MAX];
	float weight[CHANWATCH_MAX][NOISE_BUCKETS];
	size_t count;
	uint64_t decayed_ms;
	uint64_t hold_until_ms;
};

/* Shares are in hundredths of a percent of the readings at or above the threshold. */
struct chanwatch_move {
	uint8_t to;
	uint16_t home_share;
	uint16_t to_share;
};

/* Takes at most CHANWATCH_MAX channels. */
void chanwatch_init(struct chanwatch *w, const uint8_t *channels, size_t n, uint64_t now_ms);

/* dbm holds one reading per channel in the order given to chanwatch_init; home's is skipped, since
 * a scan of the home channel reads the keyboard's own packets as noise. */
void chanwatch_round(struct chanwatch *w, const int8_t *dbm, uint8_t home, uint64_t now_ms);

/* Adds readings taken between keyboard packets on home. */
void chanwatch_home(struct chanwatch *w, uint8_t home, const struct noise_tally *t);

/*
 * Returns true with the channel to move to when one is clearly quieter than home at the keyboard's
 * level, weakest_dbm being its weakest recent packet; a true return starts the hold before the next
 * move.
 */
bool chanwatch_decide(struct chanwatch *w, uint8_t home, int8_t weakest_dbm, uint64_t now_ms,
		      struct chanwatch_move *out);

/* Starts the hold before the next move. */
void chanwatch_hold(struct chanwatch *w, uint64_t now_ms);

#endif
```

## src/core.c
```c
#include <string.h>
#include <zephyr/drivers/watchdog.h>
#include <zephyr/kernel.h>
#include <zephyr/sys/printk.h>
#include "core.h"
#include "diag.h"
#include "indicator.h"
#include "store.h"
#include "usb.h"

#define USB_RETRY_MS 2
#define SCAN_PERIOD_MS 250

/* Must outlast one radio_survey call, which blocks for about 1.5 s. */
#define WATCHDOG_TIMEOUT_MS 3000

const uint8_t core_firmware_version[3] = {FIRMWARE_VERSION_MAJOR, FIRMWARE_VERSION_MINOR,
					  FIRMWARE_VERSION_PATCH};

K_MSGQ_DEFINE(rx_queue, sizeof(struct rx_item), 64, 4);
static K_MUTEX_DEFINE(reports_lock);
static struct k_sem reports_ready[REPORT_IFACES];

static enum protocol active;
static uint32_t boot_reset_cause;
static struct reports reports;
static atomic_t host_leds;
static atomic_t leds_changed;
static atomic_t rx_dropped;
static atomic_t usb_retries;
static struct history history;
static uint32_t counts[CORE_COUNTERS];
static const struct core_loop *loop;
static int64_t last_key_ms = -1;
static bool usb_was_suspended;
static bool usb_seen_live;
static struct chanwatch watch;
static int64_t last_scan_ms;
/* The keyboard sends a release on the channel a move leaves, so a key down at a move stays down on
 * the host until the keyboard finds the new one. */
#define MOVE_KEY_WAIT_MS 1000

static bool move_pending;
static bool request_waiting;
static struct diag_request waiting_request;
static int64_t request_wait_until;
static struct chanwatch_move pending_move;

static const struct device *const wdt = DEVICE_DT_GET(DT_ALIAS(watchdog0));
static int wdt_channel = -1;

static void watchdog_start(void)
{
	struct wdt_timeout_cfg cfg = {
		.window = {.min = 0, .max = WATCHDOG_TIMEOUT_MS},
		.flags = WDT_FLAG_RESET_SOC,
	};

	wdt_channel = wdt_install_timeout(wdt, &cfg);
	if (wdt_channel < 0 || wdt_setup(wdt, WDT_OPT_PAUSE_HALTED_BY_DBG) != 0) {
		printk("watchdog not running\n");
		wdt_channel = -1;
	}
}

void core_watchdog_feed(void)
{
	if (wdt_channel >= 0) {
		wdt_feed(wdt, wdt_channel);
	}
}

void core_on_radio_rx(const uint8_t *data, size_t len, uint8_t pipe, int8_t rssi)
{
	struct rx_item item = {.len = len, .pipe = pipe, .rssi = rssi};

	memcpy(item.data, data, MIN(len, sizeof(item.data)));
	if (k_msgq_put(&rx_queue, &item, K_NO_WAIT) != 0) {
		atomic_inc(&rx_dropped);
	}
}

void core_start_radio(const struct radio_config *rc)
{
	int err;

	while ((err = radio_start(rc, core_on_radio_rx)) != 0) {
		indicator_set(IND_ERROR);
		printk("radio start failed: %d\n", err);
		k_sleep(K_SECONDS(1));
		core_watchdog_feed();
	}
}

bool core_take_rx(struct rx_item *out, k_timeout_t wait)
{
	return k_msgq_get(&rx_queue, out, wait) == 0;
}

uint32_t core_rx_dropped(void)
{
	return (uint32_t)atomic_get(&rx_dropped);
}

static void lock_reports(void)
{
	k_mutex_lock(&reports_lock, K_FOREVER);
}

static void unlock_reports(bool wake_senders)
{
	k_mutex_unlock(&reports_lock);
	if (wake_senders) {
		for (int iface = 0; iface < REPORT_IFACES; iface++) {
			k_sem_give(&reports_ready[iface]);
		}
	}
}

bool core_submit(const struct report *r)
{
	bool changed;

	lock_reports();
	changed = reports_update(&reports, r);
	unlock_reports(changed);
	if (changed) {
		last_key_ms = k_uptime_get();
	}
	if (changed && usb_suspended()) {
		usb_wakeup();
	}
	return changed;
}

void core_release_keys(void)
{
	lock_reports();
	reports_release_all(&reports);
	unlock_reports(true);
}

uint32_t core_usb_retries(void)
{
	return (uint32_t)atomic_get(&usb_retries);
}

uint32_t core_merges(void)
{
	uint32_t merges;

	lock_reports();
	merges = reports.merges;
	unlock_reports(false);
	return merges;
}

static struct history_totals totals(void)
{
	return (struct history_totals){
		.packets = counts[CORE_PACKETS],
		.invalid = counts[CORE_INVALID],
		.dropped = core_rx_dropped(),
		.channel_changes = counts[CORE_CHANNEL_CHANGES],
		.link_losses = counts[CORE_LINK_LOSSES],
		.usb_retries = core_usb_retries(),
		.gaps = counts[CORE_GAPS],
	};
}

static void log_event(uint8_t type, uint8_t a, uint8_t b, uint8_t c, uint32_t value)
{
	history_event(&history, &(struct history_event){.time_ms = k_uptime_get(),
							.type = type,
							.a = a,
							.b = b,
							.c = c,
							.value = value});
}

static void take_noise(void)
{
	struct noise_tally t;
	uint8_t channel = radio_noise_take(&t);
	int home = loop->home();
	bool on_home = home != CORE_NO_HOME && channel == home;

	history_noise(&history, &t, on_home);
	if (on_home) {
		chanwatch_home(&watch, channel, &t);
	}
}

void core_start_history(const struct core_loop *l)
{
	loop = l;
	chanwatch_init(&watch, l->candidates, l->candidates_len, k_uptime_get());
	history_init(&history, k_uptime_get(), &(struct history_totals){0});
	log_event(HISTORY_BOOT, 0, 0, 0, boot_reset_cause);
}

void core_count(enum core_counter c)
{
	counts[c]++;
}

void core_log(uint8_t type, uint8_t a, uint8_t b, uint8_t c, uint32_t value)
{
	take_noise();
	log_event(type, a, b, c, value);
}

void core_log_pairing_opened(const struct pairwin *w)
{
	core_log(HISTORY_PAIRING_OPENED, w->cause, w->until_paired, 0, 0);
}

void core_rssi(int8_t dbm)
{
	take_noise();
	history_rssi(&history, dbm);
}

uint8_t core_minutes_since_key(void)
{
	int64_t minutes;

	if (last_key_ms < 0) {
		return UINT8_MAX;
	}
	minutes = (k_uptime_get() - last_key_ms) / HISTORY_MINUTE_MS;
	return minutes > UINT8_MAX ? UINT8_MAX : (uint8_t)minutes;
}

static void scan(void)
{
	int64_t now = k_uptime_get();
	size_t n = MIN(loop->candidates_len, CHANWATCH_MAX);
	int8_t dbm[CHANWATCH_MAX];
	int8_t weakest;
	int home;

	if (n == 0 || now - last_scan_ms < SCAN_PERIOD_MS) {
		return;
	}
	home = loop->movable();
	if (home == CORE_NO_HOME) {
		return;
	}
	last_scan_ms = now;
	/* Stopping the receiver drops the noise readings not yet taken. */
	take_noise();
	if (radio_sample(loop->candidates, n, dbm) != 0) {
		return;
	}
	loop->replies_dropped();
	chanwatch_round(&watch, dbm, (uint8_t)home, (uint64_t)now);
	if (history_weakest(&history, &weakest) &&
	    chanwatch_decide(&watch, (uint8_t)home, weakest, (uint64_t)now, &pending_move)) {
		move_pending = true;
	}
}

static bool keys_held(void)
{
	bool held;

	lock_reports();
	held = reports_any_held(&reports);
	unlock_reports(false);
	return held;
}

static enum diag_error apply_move(uint8_t to, uint8_t reason, uint32_t value, uint8_t *from)
{
	enum chanmove_result result = loop->move(to, from);

	if (result == CHANMOVE_NOT_A_CHANNEL) {
		return DIAG_ERR_BAD_CHANNELS;
	}
	if (result == CHANMOVE_NOT_MOVABLE) {
		return DIAG_ERR_NOT_MOVABLE;
	}
	if (to == *from) {
		return 0;
	}
	if (core_set_channel(to) != 0) {
		return DIAG_ERR_RADIO;
	}
	if (loop->replies_dropped != NULL) {
		loop->replies_dropped();
	}
	/* A noise move decided before this one would undo it. */
	move_pending = false;
	chanwatch_hold(&watch, (uint64_t)k_uptime_get());
	core_log(HISTORY_LINK_MOVED, *from, to, reason, value);
	return 0;
}

static void poll_noise_move(void)
{
	uint8_t from;

	if (!move_pending || keys_held()) {
		return;
	}
	move_pending = false;
	apply_move(pending_move.to, HISTORY_MOVED_FOR_NOISE,
		   (uint32_t)pending_move.home_share << 16 | pending_move.to_share, &from);
}

static void poll_move_request(void)
{
	enum diag_error err;
	uint8_t from;

	if (!request_waiting) {
		return;
	}
	if (keys_held()) {
		if (k_uptime_get() >= request_wait_until) {
			request_waiting = false;
			diag_reply_error(&waiting_request, DIAG_ERR_KEY_HELD, 0);
		}
		return;
	}
	request_waiting = false;
	err = apply_move((uint8_t)waiting_request.arg, HISTORY_MOVED_ON_REQUEST, 0, &from);
	if (err != 0) {
		diag_reply_error(&waiting_request, err, 0);
	} else {
		diag_reply(&waiting_request, &from, 1, DIAG_AFTER_NONE);
	}
}

void core_poll(void)
{
	bool suspended = usb_suspended();
	struct history_totals t;

	usb_seen_live |= usb_live();
	if (suspended != usb_was_suspended) {
		if (usb_seen_live) {
			core_log(suspended ? HISTORY_USB_SUSPEND : HISTORY_USB_RESUME, 0, 0, 0, 0);
		}
		usb_was_suspended = suspended;
	}
	take_noise();
	scan();
	poll_noise_move();
	poll_move_request();
	t = totals();
	history_tick(&history, k_uptime_get(), &t);
}

int core_set_channel(uint8_t channel)
{
	int err;

	take_noise();
	err = radio_set_channel(channel);
	if (err == 0) {
		core_count(CORE_CHANNEL_CHANGES);
	}
	return err;
}

const struct chan_survey *core_survey(void)
{
	static struct chan_survey survey;

	take_noise();
	core_watchdog_feed();
	return radio_survey(&survey) == 0 ? &survey : NULL;
}

static void clear(const struct diag_request *req)
{
	lock_reports();
	reports.merges = 0;
	unlock_reports(false);
	atomic_clear(&rx_dropped);
	atomic_clear(&usb_retries);
	memset(counts, 0, sizeof(counts));
	history_clear(&history, k_uptime_get(), &(struct history_totals){0});
	log_event(HISTORY_CLEAR, 0, 0, 0, 0);
	diag_reply(req, NULL, 0, DIAG_AFTER_NONE);
}

static void serve_minutes(const struct diag_request *req, uint8_t *payload)
{
	static struct history_minute page[DIAG_MINUTES_PER_PAGE];
	uint32_t first;
	size_t n = history_minutes(&history, req->arg, &first, page, ARRAY_SIZE(page));

	diag_reply(req, payload, diag_encode_minutes(payload, first, page, n), DIAG_AFTER_NONE);
}

static void serve_events(const struct diag_request *req, uint8_t *payload)
{
	static struct history_event page[DIAG_EVENTS_PER_PAGE];
	uint32_t first;
	size_t n = history_events(&history, req->arg, &first, page, ARRAY_SIZE(page));

	diag_reply(req, payload, diag_encode_events(payload, first, page, n), DIAG_AFTER_NONE);
}

static void serve_noise(const struct diag_request *req, uint8_t *payload)
{
	const struct chan_survey *survey;

	/* The receiver goes deaf during the survey, so a key held now stays down on the host. */
	core_release_keys();
	survey = core_survey();
	if (survey == NULL) {
		diag_reply_error(req, DIAG_ERR_RADIO, 0);
		return;
	}
	loop->radio_resumed();
	log_event(HISTORY_NOISE, 0, 0, 0, 0);
	diag_reply(req, payload, diag_encode_noise(payload, survey), DIAG_AFTER_NONE);
}

bool core_take_leds(uint8_t *leds)
{
	bool changed = atomic_clear(&leds_changed) != 0;

	*leds = (uint8_t)atomic_get(&host_leds);
	return changed;
}

void core_show_state(enum indicator_mode mode)
{
	indicator_set(usb_suspended() ? IND_SLEEP : mode);
}

static void usb_thread(void *a, void *b, void *c)
{
	enum report_iface iface = (enum report_iface)(uintptr_t)a;

	for (;;) {
		struct report r;
		bool have;

		lock_reports();
		have = reports_peek(&reports, iface, &r);
		if (have) {
			reports_pop(&reports, iface);
		}
		unlock_reports(false);
		if (!have) {
			k_sem_take(&reports_ready[iface], K_FOREVER);
			continue;
		}
		while (usb_send(&r) != 0 && usb_live()) {
			atomic_inc(&usb_retries);
			k_msleep(USB_RETRY_MS);
		}
	}
}

K_THREAD_DEFINE(keyboard_tid, 1024, usb_thread, (void *)REPORT_IFACE_KEYBOARD, NULL, NULL, 5, 0,
		SYS_FOREVER_MS);
K_THREAD_DEFINE(extra_tid, 1024, usb_thread, (void *)REPORT_IFACE_EXTRA, NULL, NULL, 5, 0,
		SYS_FOREVER_MS);

static void on_usb_live(void)
{
	lock_reports();
	reports_set_live(&reports, usb_live());
	unlock_reports(true);
}

static void on_usb_leds(uint8_t leds)
{
	atomic_set(&host_leds, leds);
	atomic_set(&leds_changed, 1);
}

void core_start(enum protocol protocol, uint32_t reset_cause)
{
	static const struct usb_callbacks usb_cb = {
		.on_live = on_usb_live,
		.on_leds = on_usb_leds,
		.on_diag_request = diag_on_request,
	};
	int err;

	active = protocol;
	boot_reset_cause = reset_cause;
	reports_init(&reports);
	for (int iface = 0; iface < REPORT_IFACES; iface++) {
		k_sem_init(&reports_ready[iface], 0, 1);
	}
	err = usb_start(&usb_cb);
	if (err) {
		printk("usb start failed: %d\n", err);
	}
	k_thread_start(keyboard_tid);
	k_thread_start(extra_tid);
	watchdog_start();
}

uint32_t core_reset_cause(void)
{
	return boot_reset_cause;
}

void core_fill_status(struct diag_status *st)
{
	*st = (struct diag_status){
		.uptime_ms = (uint64_t)k_uptime_get(),
		.reset_cause = boot_reset_cause,
		.protocol = active,
		.usb_live = usb_live(),
		.usb_suspended = usb_suspended(),
	};
	memcpy(st->firmware_version, core_firmware_version, sizeof(st->firmware_version));
	st->totals = totals();
	st->merges = core_merges();
	st->surveys = counts[CORE_SURVEYS];
	st->minute_next = history.minute_next;
	st->minute_oldest = history.minute_oldest;
	st->events_total = history.events_total;
	st->events_oldest = history.events_oldest;
}

static void serve_status(const struct diag_request *req, uint8_t *payload)
{
	struct diag_status st;

	core_fill_status(&st);
	loop->fill_status(&st);
	diag_reply(req, payload, diag_encode_status(payload, &st), DIAG_AFTER_NONE);
}

static void serve_protocol(const struct diag_request *req)
{
	enum protocol want;
	uint8_t reply[2] = {active, 0};
	int err;

	if (req->arg == 0) {
		diag_reply(req, reply, sizeof(reply), DIAG_AFTER_NONE);
		return;
	}
	if (!protocol_from_arg(req->arg, &want)) {
		diag_reply_error(req, DIAG_ERR_UNKNOWN_COMMAND, 0);
		return;
	}
	if (want == active) {
		diag_reply(req, reply, sizeof(reply), DIAG_AFTER_NONE);
		return;
	}
	/* A protocol saved without its rebooting reply takes effect at an unrelated later reboot. */
	if (!diag_reply_fits(sizeof(reply))) {
		return;
	}
	err = store_save_protocol(want);
	if (err) {
		printk("saving the protocol failed: %d\n", err);
		diag_reply_error(req, DIAG_ERR_STORE, 0);
		return;
	}
	reply[1] = 1;
	diag_reply(req, reply, sizeof(reply), DIAG_AFTER_REBOOT);
}

static void serve_move(const struct diag_request *req)
{
	if (req->arg > UINT8_MAX) {
		diag_reply_error(req, DIAG_ERR_BAD_CHANNELS, 0);
		return;
	}
	waiting_request = *req;
	request_waiting = true;
	request_wait_until = k_uptime_get() + MOVE_KEY_WAIT_MS;
	poll_move_request();
}

bool core_take_request(struct diag_request *out)
{
	static uint8_t payload[DIAG_PAYLOAD_MAX];

	while (diag_take_request(out)) {
		uint8_t owner = diag_command_protocol(out->command);

		if (owner != 0 && owner != active) {
			diag_reply_error(out, DIAG_ERR_WRONG_PROTOCOL, active);
			continue;
		}
		switch (out->command) {
		case DIAG_STATUS:
			serve_status(out, payload);
			break;
		case DIAG_PROTOCOL:
			serve_protocol(out);
			break;
		case DIAG_REBOOT:
			diag_reply(out, NULL, 0, DIAG_AFTER_REBOOT);
			break;
		case DIAG_BOOTLOADER:
			diag_reply(out, NULL, 0, DIAG_AFTER_BOOTLOADER);
			break;
		case DIAG_HISTORY:
			serve_minutes(out, payload);
			break;
		case DIAG_EVENTS:
			serve_events(out, payload);
			break;
		case DIAG_NOISE:
			serve_noise(out, payload);
			break;
		case DIAG_CLEAR:
			clear(out);
			break;
		case DIAG_MOVE:
			serve_move(out);
			break;
		default:
			return true;
		}
	}
	return false;
}
```

## src/core.h
```c
#ifndef CORE_H
#define CORE_H

#include <stdbool.h>
#include <stdint.h>
#include <zephyr/kernel.h>
#include "chanmove.h"
#include "chanpick.h"
#include "chanwatch.h"
#include "diagproto.h"
#include "history.h"
#include "indicator.h"
#include "pairwin.h"
#include "protocol.h"
#include "radio.h"
#include "reports.h"

#define CORE_NO_HOME (-1)

enum core_counter {
	CORE_PACKETS,
	CORE_INVALID,
	CORE_CHANNEL_CHANGES,
	CORE_LINK_LOSSES,
	CORE_GAPS,
	CORE_SURVEYS,
	CORE_COUNTERS,
};

/* What the core asks of the running protocol loop. */
struct core_loop {
	/* The channel whose noise counts toward the minute, or CORE_NO_HOME. */
	int (*home)(void);
	/* Runs after each survey that answers a noise request, which keeps the receiver off. */
	void (*radio_resumed)(void);
	void (*fill_status)(struct diag_status *st);
	/* Channels the dongle may move to for less noise; empty for a protocol that does not
	 * move. */
	const uint8_t *candidates;
	size_t candidates_len;
	/* The home channel while a noise move is allowed, or CORE_NO_HOME; required with
	 * candidates. */
	int (*movable)(void);
	/* Runs after each scan round or move, which drops the replies queued on the
	 * radio; required with candidates. */
	void (*replies_dropped)(void);
	/* Moves the protocol state for a requested or noise move; *from is the channel before it. */
	enum chanmove_result (*move)(uint8_t channel, uint8_t *from);
};

struct rx_item {
	uint8_t len;
	uint8_t pipe;
	int8_t rssi;
	uint8_t data[RADIO_MAX_PAYLOAD];
};

extern const uint8_t core_firmware_version[3];

/* Starts USB, the report senders and the watchdog for the protocol this boot runs. */
void core_start(enum protocol active, uint32_t reset_cause);
uint32_t core_reset_cause(void);
void core_on_radio_rx(const uint8_t *data, size_t len, uint8_t pipe, int8_t rssi);
/* Blocks until the radio starts, retrying each second. */
void core_start_radio(const struct radio_config *rc);
bool core_take_rx(struct rx_item *out, k_timeout_t wait);
uint32_t core_rx_dropped(void);
/* Returns true when the report changed what the host sees; a change wakes a suspended host. */
bool core_submit(const struct report *r);
void core_release_keys(void);
uint32_t core_usb_retries(void);
uint32_t core_merges(void);
/* Returns true once after each host LED change; *leds always receives the current LEDs. */
bool core_take_leds(uint8_t *leds);
void core_watchdog_feed(void);
/* A suspended host shows IND_SLEEP whatever the mode. */
void core_show_state(enum indicator_mode mode);
/* Starts the history with a boot event; loop must stay valid for the rest of the program. */
void core_start_history(const struct core_loop *loop);
void core_count(enum core_counter c);
/* Takes the pending noise readings first, which a gap or loss event records. */
void core_log(uint8_t type, uint8_t a, uint8_t b, uint8_t c, uint32_t value);
void core_log_pairing_opened(const struct pairwin *w);
/* Takes the pending noise readings first. */
void core_rssi(int8_t dbm);
/* UINT8_MAX when no report has changed what the host sees since boot, or 255 minutes or more ago. */
uint8_t core_minutes_since_key(void);
/* Logs USB suspend changes and closes the minutes that ended. */
void core_poll(void);
/* Takes the pending noise readings, which a channel change drops, and counts a change that
 * succeeds. */
int core_set_channel(uint8_t channel);
/* Takes the pending noise readings, which a survey drops. Blocks for about 1.5 s with the receiver
 * off; returns NULL when the radio failed. */
const struct chan_survey *core_survey(void);
/* Sets the fields every protocol reports and zeroes the rest; loop.fill_status adds the
 * protocol's own. */
void core_fill_status(struct diag_status *st);
/* Answers status, protocol, reboot, bootloader, history, events, clear and noise requests, and
 * requests for the other protocol's commands, itself; returns true with the next request it does
 * not answer. */
bool core_take_request(struct diag_request *out);

FUNC_NORETURN void nuphy_run(int store_err);
FUNC_NORETURN void unifying_run(int store_err);

#endif
```

## src/diag.c
```c
#include <zephyr/kernel.h>
#include <zephyr/sys/reboot.h>
#include "diag.h"
#include "usb.h"

#define DIAG_PART_SLOTS 16

struct diag_part {
	uint8_t report[DIAG_REPORT_LEN];
	uint8_t after;
};

BUILD_ASSERT(DIAG_PART_SLOTS * DIAG_CHUNK >= DIAG_PAYLOAD_MAX);

K_MSGQ_DEFINE(diag_requests, sizeof(struct diag_request), 4, 4);
K_MSGQ_DEFINE(diag_parts, sizeof(struct diag_part), DIAG_PART_SLOTS, 4);

void diag_on_request(const uint8_t *buf, size_t len)
{
	struct diag_request req;

	if (diag_parse_request(buf, len, &req)) {
		k_msgq_put(&diag_requests, &req, K_NO_WAIT);
	}
}

bool diag_take_request(struct diag_request *out)
{
	return k_msgq_get(&diag_requests, out, K_NO_WAIT) == 0;
}

bool diag_reply_fits(size_t len)
{
	return k_msgq_num_free_get(&diag_parts) >= diag_part_count(len);
}

void diag_reply(const struct diag_request *req, const uint8_t *payload, size_t len,
		enum diag_after after)
{
	size_t count = diag_part_count(len);

	if (!diag_reply_fits(len)) {
		return;
	}
	for (size_t i = 0; i < count; i++) {
		struct diag_part p = {.after = i + 1 == count ? after : DIAG_AFTER_NONE};

		diag_part(p.report, req, payload, len, i);
		k_msgq_put(&diag_parts, &p, K_NO_WAIT);
	}
}

void diag_reply_error(const struct diag_request *req, enum diag_error code, uint8_t detail)
{
	struct diag_part p = {.after = DIAG_AFTER_NONE};

	diag_error_report(p.report, req, code, detail);
	k_msgq_put(&diag_parts, &p, K_NO_WAIT);
}

static void diag_thread(void *a, void *b, void *c)
{
	for (;;) {
		struct diag_part p;

		k_msgq_get(&diag_parts, &p, K_FOREVER);
		usb_diag_send(p.report);
		if (p.after == DIAG_AFTER_REBOOT) {
			sys_reboot(SYS_REBOOT_COLD);
		} else if (p.after == DIAG_AFTER_BOOTLOADER) {
			usb_reboot_to_bootloader();
		}
	}
}

K_THREAD_DEFINE(diag_tid, 1024, diag_thread, NULL, NULL, NULL, 7, 0, 0);
```

## src/diag.h
```c
#ifndef DIAG_H
#define DIAG_H

#include <stdbool.h>
#include <stddef.h>
#include <stdint.h>
#include "diagproto.h"

enum diag_after {
	DIAG_AFTER_NONE,
	DIAG_AFTER_REBOOT,
	DIAG_AFTER_BOOTLOADER,
};

/* A request arriving while the queue is full is dropped. */
void diag_on_request(const uint8_t *buf, size_t len);
bool diag_take_request(struct diag_request *out);

/*
 * Never blocks: a reply that does not fit in the free part slots is dropped whole. after runs once
 * the host has read the last part.
 */
void diag_reply(const struct diag_request *req, const uint8_t *payload, size_t len,
		enum diag_after after);
bool diag_reply_fits(size_t len);
void diag_reply_error(const struct diag_request *req, enum diag_error code, uint8_t detail);

#endif
```

## src/diagproto.c
```c
#include <string.h>
#include "diagproto.h"

static uint8_t *put_le(uint8_t *p, uint64_t v, size_t bytes)
{
	for (size_t i = 0; i < bytes; i++) {
		*p++ = v >> (8 * i);
	}
	return p;
}

uint8_t diag_command_protocol(uint8_t command)
{
	switch (command) {
	case DIAG_FORCE_CHANNELS:
		return PROTOCOL_NUPHY;
	default:
		return 0;
	}
}

bool diag_parse_request(const uint8_t *buf, size_t len, struct diag_request *out)
{
	if (len < DIAG_REQUEST_LEN) {
		return false;
	}
	out->command = buf[0];
	out->seq = buf[1];
	out->arg = buf[2] | buf[3] << 8 | buf[4] << 16 | (uint32_t)buf[5] << 24;
	return true;
}

bool diag_channels_arg(uint32_t arg, uint8_t out[3])
{
	for (int i = 0; i < 3; i++) {
		out[i] = arg >> (8 * i);
	}
	return arg != 0;
}

size_t diag_part_count(size_t payload_len)
{
	return payload_len == 0 ? 1 : (payload_len + DIAG_CHUNK - 1) / DIAG_CHUNK;
}

void diag_part(uint8_t out[DIAG_REPORT_LEN], const struct diag_request *req,
	       const uint8_t *payload, size_t len, size_t part)
{
	size_t offset = part * DIAG_CHUNK;
	size_t n = len > offset ? len - offset : 0;

	memset(out, 0, DIAG_REPORT_LEN);
	out[0] = req->command;
	out[1] = req->seq;
	out[2] = part;
	out[3] = diag_part_count(len);
	if (n > 0) {
		memcpy(out + DIAG_HEADER_LEN, payload + offset, n < DIAG_CHUNK ? n : DIAG_CHUNK);
	}
}

void diag_error_report(uint8_t out[DIAG_REPORT_LEN], const struct diag_request *req,
		       enum diag_error code, uint8_t detail)
{
	memset(out, 0, DIAG_REPORT_LEN);
	out[0] = req->command | DIAG_ERROR_FLAG;
	out[1] = req->seq;
	out[3] = 1;
	out[DIAG_HEADER_LEN] = code;
	out[DIAG_HEADER_LEN + 1] = detail;
}

size_t diag_encode_status(uint8_t *out, const struct diag_status *s)
{
	uint8_t *p = out;

	*p++ = DIAG_VERSION;
	memcpy(p, s->firmware_version, sizeof(s->firmware_version));
	p += sizeof(s->firmware_version);
	p = put_le(p, s->uptime_ms, 8);
	p = put_le(p, s->reset_cause, 4);
	*p++ = s->link_state;
	*p++ = s->channel;
	memcpy(p, s->own, sizeof(s->own));
	p += sizeof(s->own);
	memcpy(p, s->forced, sizeof(s->forced));
	p += sizeof(s->forced);
	memcpy(p, s->keyboard_id, sizeof(s->keyboard_id));
	p += sizeof(s->keyboard_id);
	*p++ = (uint8_t)s->last_rssi;
	p = put_le(p, s->last_rx_age_ms, 4);
	*p++ = (s->usb_live ? 1 : 0) | (s->usb_suspended ? 2 : 0);
	p = put_le(p, s->totals.packets, 4);
	p = put_le(p, s->totals.invalid, 4);
	p = put_le(p, s->totals.dropped, 4);
	p = put_le(p, s->totals.channel_changes, 4);
	p = put_le(p, s->totals.link_losses, 4);
	p = put_le(p, s->totals.usb_retries, 4);
	p = put_le(p, s->totals.gaps, 4);
	p = put_le(p, s->merges, 4);
	p = put_le(p, s->surveys, 4);
	p = put_le(p, s->minute_next, 4);
	p = put_le(p, s->minute_oldest, 4);
	p = put_le(p, s->events_total, 4);
	p = put_le(p, s->events_oldest, 4);
	*p++ = s->protocol;
	*p++ = s->pairing_open ? 1 : 0;
	return p - out;
}

static uint8_t *put_noise(uint8_t *p, const struct noise_record *n)
{
	*p++ = (uint8_t)n->peak;
	p = put_le(p, n->busy, 2);
	return put_le(p, n->strong, 2);
}

size_t diag_encode_minutes(uint8_t *out, uint32_t first, const struct history_minute *m, size_t n)
{
	uint8_t *p = put_le(out, first, 4);

	*p++ = n;
	for (size_t i = 0; i < n; i++) {
		p = put_le(p, m[i].packets, 2);
		*p++ = m[i].invalid;
		*p++ = m[i].dropped;
		*p++ = m[i].channel_changes;
		*p++ = m[i].link_losses;
		*p++ = m[i].usb_retries;
		*p++ = m[i].gaps;
		*p++ = (uint8_t)m[i].rssi_min;
		*p++ = (uint8_t)m[i].rssi_avg;
		*p++ = (uint8_t)m[i].rssi_max;
		p = put_noise(p, &m[i].noise);
	}
	return p - out;
}

size_t diag_encode_events(uint8_t *out, uint32_t first, const struct history_event *e, size_t n)
{
	uint8_t *p = put_le(out, first, 4);

	*p++ = n;
	for (size_t i = 0; i < n; i++) {
		p = put_le(p, e[i].time_ms, 8);
		*p++ = e[i].type;
		*p++ = e[i].a;
		*p++ = e[i].b;
		*p++ = e[i].c;
		p = put_le(p, e[i].value, 4);
		p = put_noise(p, &e[i].noise);
	}
	return p - out;
}

size_t diag_encode_noise(uint8_t *out, const struct chan_survey *s)
{
	uint8_t *p = out;

	*p++ = CHAN_FIRST;
	*p++ = CHAN_COUNT;
	for (int i = 0; i < CHAN_COUNT; i++) {
		int8_t loudest = s->dbm[i][0];
		int32_t sum = 0;

		for (int k = 0; k < CHAN_SAMPLES; k++) {
			if (s->dbm[i][k] > loudest) {
				loudest = s->dbm[i][k];
			}
			sum += s->dbm[i][k];
		}
		*p++ = (uint8_t)loudest;
		*p++ = (uint8_t)(int8_t)(sum / CHAN_SAMPLES);
	}
	return p - out;
}
```

## src/diagproto.h
```c
#ifndef DIAGPROTO_H
#define DIAGPROTO_H

#include <stdbool.h>
#include <stddef.h>
#include <stdint.h>

#include "chanpick.h"
#include "history.h"
#include "protocol.h"

/* Bumped only when a layout that a release has shipped changes. */
#define DIAG_VERSION 2
#define DIAG_REPORT_LEN 64
#define DIAG_HEADER_LEN 4
#define DIAG_CHUNK (DIAG_REPORT_LEN - DIAG_HEADER_LEN)
#define DIAG_REQUEST_LEN 6
#define DIAG_ERROR_FLAG 0x80
#define DIAG_PAYLOAD_MAX 704
#define DIAG_MINUTES_PER_PAGE 40
#define DIAG_EVENTS_PER_PAGE 32

enum diag_command {
	DIAG_STATUS = 1,
	DIAG_HISTORY,
	DIAG_EVENTS,
	DIAG_NOISE,
	DIAG_REBOOT,
	DIAG_BOOTLOADER,
	DIAG_CLEAR,
	DIAG_FORCE_CHANNELS,
	DIAG_PAIR,
	/* arg 0 reads; 1 or 2 sets. The reply is the running protocol, then 1 if the dongle
	 * reboots to apply a changed protocol. */
	DIAG_PROTOCOL,
	/* arg is the channel; the reply is the channel the link was on. */
	DIAG_MOVE,
};

enum diag_error {
	DIAG_ERR_UNKNOWN_COMMAND = 1,
	DIAG_ERR_RADIO,
	DIAG_ERR_BAD_CHANNELS,
	DIAG_ERR_STORE,
	DIAG_ERR_WRONG_PROTOCOL,
	DIAG_ERR_NOT_MOVABLE,
	DIAG_ERR_KEY_HELD,
};

struct diag_request {
	uint8_t command;
	uint8_t seq;
	uint32_t arg;
};

struct diag_status {
	uint8_t firmware_version[3];
	uint64_t uptime_ms;
	uint32_t reset_cause;
	uint8_t link_state;
	uint8_t channel;
	uint8_t own[3];
	/* All zero while pairing surveys. */
	uint8_t forced[3];
	uint8_t keyboard_id[4];
	int8_t last_rssi;
	uint32_t last_rx_age_ms;
	bool usb_live;
	bool usb_suspended;
	struct history_totals totals;
	uint32_t merges;
	uint32_t surveys;
	uint32_t minute_next;
	uint32_t minute_oldest;
	uint32_t events_total;
	uint32_t events_oldest;
	uint8_t protocol;
	bool pairing_open;
};

/* Returns false for a report shorter than DIAG_REQUEST_LEN. */
bool diag_parse_request(const uint8_t *buf, size_t len, struct diag_request *out);
/* Returns false for an arg of zero, which clears the forced channels. */
bool diag_channels_arg(uint32_t arg, uint8_t out[3]);
size_t diag_part_count(size_t payload_len);
void diag_part(uint8_t out[DIAG_REPORT_LEN], const struct diag_request *req,
	       const uint8_t *payload, size_t len, size_t part);
/* detail is the active protocol for DIAG_ERR_WRONG_PROTOCOL and 0 otherwise. */
void diag_error_report(uint8_t out[DIAG_REPORT_LEN], const struct diag_request *req,
		       enum diag_error code, uint8_t detail);
/* Returns 0 for a command every protocol answers. */
uint8_t diag_command_protocol(uint8_t command);
size_t diag_encode_status(uint8_t *out, const struct diag_status *s);
size_t diag_encode_minutes(uint8_t *out, uint32_t first, const struct history_minute *m,
			  size_t n);
size_t diag_encode_events(uint8_t *out, uint32_t first, const struct history_event *e,
			 size_t n);
size_t diag_encode_noise(uint8_t *out, const struct chan_survey *s);

#endif
```

## src/history.c
```c
#include <string.h>
#include "history.h"

static uint16_t sat16(uint32_t v)
{
	return v > UINT16_MAX ? UINT16_MAX : v;
}

static uint8_t sat8(uint32_t v)
{
	return v > UINT8_MAX ? UINT8_MAX : v;
}

static void reset_minute(struct history *h)
{
	h->rssi_sum = 0;
	h->rssi_count = 0;
	h->rssi_min = 0;
	h->rssi_max = 0;
	h->noise = (struct noise_tally){0};
}

void history_clear(struct history *h, uint64_t now_ms, const struct history_totals *t)
{
	h->minute_next = now_ms / HISTORY_MINUTE_MS;
	h->minute_oldest = h->minute_next;
	h->at_minute_start = *t;
	h->events_oldest = h->events_total;
	h->since_packet = (struct noise_tally){0};
	reset_minute(h);
}

void history_init(struct history *h, uint64_t now_ms, const struct history_totals *t)
{
	memset(h, 0, sizeof(*h));
	history_clear(h, now_ms, t);
}

static struct history_minute close_minute(const struct history *h, const struct history_totals *t)
{
	const struct history_totals *s = &h->at_minute_start;
	struct history_minute m = {
		.packets = sat16(t->packets - s->packets),
		.invalid = sat8(t->invalid - s->invalid),
		.dropped = sat8(t->dropped - s->dropped),
		.channel_changes = sat8(t->channel_changes - s->channel_changes),
		.link_losses = sat8(t->link_losses - s->link_losses),
		.usb_retries = sat8(t->usb_retries - s->usb_retries),
		.gaps = sat8(t->gaps - s->gaps),
	};

	if (h->rssi_count > 0) {
		m.rssi_min = h->rssi_min;
		m.rssi_max = h->rssi_max;
		m.rssi_avg = h->rssi_sum / (int32_t)h->rssi_count;
	}
	m.noise = noise_record(&h->noise);
	return m;
}

void history_tick(struct history *h, uint64_t now_ms, const struct history_totals *t)
{
	uint32_t minute = now_ms / HISTORY_MINUTE_MS;

	while (h->minute_next < minute) {
		h->minutes[h->minute_next % HISTORY_MINUTES] = close_minute(h, t);
		h->minute_next++;
		if (h->minute_next - h->minute_oldest > HISTORY_MINUTES) {
			h->minute_oldest = h->minute_next - HISTORY_MINUTES;
		}
		h->at_minute_start = *t;
		reset_minute(h);
	}
}

void history_rssi(struct history *h, int8_t dbm)
{
	if (h->rssi_count == 0 || dbm < h->rssi_min) {
		h->rssi_min = dbm;
	}
	if (h->rssi_count == 0 || dbm > h->rssi_max) {
		h->rssi_max = dbm;
	}
	h->rssi_sum += dbm;
	h->rssi_count++;
	h->since_packet = (struct noise_tally){0};
}

void history_noise(struct history *h, const struct noise_tally *t, bool home)
{
	noise_merge(&h->since_packet, t);
	if (home) {
		noise_merge(&h->noise, t);
	}
}

void history_event(struct history *h, const struct history_event *e)
{
	struct history_event *stored = &h->events[h->events_total % HISTORY_EVENTS];

	*stored = *e;
	if (e->type == HISTORY_LINK_GAP || e->type == HISTORY_LINK_LOST) {
		stored->noise = noise_record(&h->since_packet);
		h->since_packet = (struct noise_tally){0};
	}
	h->events_total++;
	if (h->events_total - h->events_oldest > HISTORY_EVENTS) {
		h->events_oldest = h->events_total - HISTORY_EVENTS;
	}
}

size_t history_minutes(const struct history *h, uint32_t from, uint32_t *first,
		       struct history_minute *out, size_t max)
{
	uint32_t start = from < h->minute_oldest ? h->minute_oldest : from;
	size_t n = 0;

	*first = start;
	while (n < max && start + n < h->minute_next) {
		out[n] = h->minutes[(start + n) % HISTORY_MINUTES];
		n++;
	}
	return n;
}

size_t history_events(const struct history *h, uint32_t from, uint32_t *first,
		      struct history_event *out, size_t max)
{
	uint32_t start = from < h->events_oldest ? h->events_oldest : from;
	size_t n = 0;

	*first = start;
	while (n < max && start + n < h->events_total) {
		out[n] = h->events[(start + n) % HISTORY_EVENTS];
		n++;
	}
	return n;
}

bool history_weakest(const struct history *h, int8_t *out)
{
	bool found = h->rssi_count > 0;

	if (found) {
		*out = h->rssi_min;
	}
	if (h->minute_next > h->minute_oldest) {
		const struct history_minute *m =
			&h->minutes[(h->minute_next - 1) % HISTORY_MINUTES];

		if (m->rssi_min != 0 && (!found || m->rssi_min < *out)) {
			*out = m->rssi_min;
			found = true;
		}
	}
	return found;
}
```
